## bsp/xuantie/smartl/e906fdq/board/Kconfig
```kconfig
menu "Hardware Drivers Config"

config SOC_XUANTIE
    bool
    select SOC_XUANTIE_SERIES_E906
    select RT_USING_COMPONENTS_INIT
    select RT_USING_USER_MAIN
    default y


menu "On-chip Peripheral Drivers"
    config BSP_USING_GPIO
        bool "Enable GPIO"
        select RT_USING_PIN
        default y

    menuconfig BSP_USING_UART
        bool "Enable UART"
        select RT_USING_SERIAL
        default n

        if BSP_USING_UART
            config BSP_USING_UART1
                bool "Enable UART1"
                default n
        endif

endmenu

endmenu
```
